// SPDX-License-Identifier: GPL-2.0-only

/dts-v1/;

#include "sdm450-samsung.dtsi"

/ {
	qcom,msm-id = <QCOM_ID_SDA450 0>;
	qcom,board-id = <QCOM_BOARD_ID_MTP 5>;
};

&lk2nd {
	gta2xlwifi-generic {
		model = "Samsung Tab A2 XL WIFI Rev05";
		compatible = "samsung,gta2xlwifi";
		lk2nd,match-bootloader = "T590*";

		lk2nd,dtb-files = "sdm450-samsung-gta2xlwifi";
	};
};
